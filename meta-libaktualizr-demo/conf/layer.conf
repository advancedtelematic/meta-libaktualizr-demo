## meta-libaktualizr-demo/conf/layer.conf
```bitbake
# We have a conf and classes directory, add to BBPATH
BBPATH .= ":${LAYERDIR}"

# We have recipes-* directories, add to BBFILES
BBFILES += "${LAYERDIR}/recipes-*/*/*.bb \
	${LAYERDIR}/recipes-*/*/*.bbappend"

BBFILE_COLLECTIONS += "libaktualizr-demo"
BBFILE_PATTERN_libaktualizr-demo = "^${LAYERDIR}/"
BBFILE_PRIORITY_libaktualizr-demo = "7"
```
